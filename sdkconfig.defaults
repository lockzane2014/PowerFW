## sdkconfig.defaults
```kconfig
CONFIG_FREERTOS_HZ=1000
CONFIG_LOG_DEFAULT_LEVEL=3
CONFIG_LOG_COLORS=y

# Enable needed drivers
CONFIG_ENABLE_ESP_LCD=y
CONFIG_SPIRAM=y
CONFIG_SPIRAM_MODE_OCT=y

# For T-Embed display
CONFIG_LVGL_ENABLE=y
CONFIG_LVGL_USE_FREERTOS=y

# Serial monitor
CONFIG_ESP_CONSOLE_UART_DEFAULT=y
CONFIG_ESP_CONSOLE_UART_BAUDRATE=115200
```
